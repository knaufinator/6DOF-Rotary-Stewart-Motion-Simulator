## Controller/sdkconfig.defaults
```kconfig
# ESP32-S3 Configuration for Stewart Platform Motion Controller
# Native ESP-IDF configuration (no Arduino framework)

# Target configuration
CONFIG_IDF_TARGET="esp32s3"
CONFIG_IDF_TARGET_ESP32S3=y

# Serial/Console
CONFIG_ESP_CONSOLE_UART_DEFAULT=y
CONFIG_ESP_CONSOLE_UART_NUM=0
CONFIG_ESP_CONSOLE_UART_BAUDRATE=115200
CONFIG_ESP_CONSOLE_USB_CDC_SUPPORT_ETS_PRINTF=n

# FreeRTOS Configuration for real-time performance
CONFIG_FREERTOS_HZ=1000
CONFIG_FREERTOS_UNICORE=n
CONFIG_FREERTOS_USE_TRACE_FACILITY=y
CONFIG_FREERTOS_USE_STATS_FORMATTING_FUNCTIONS=y
CONFIG_FREERTOS_THREAD_LOCAL_STORAGE_POINTERS=1

# Task watchdog
CONFIG_ESP_TASK_WDT=y
CONFIG_ESP_TASK_WDT_TIMEOUT_S=5
CONFIG_ESP_TASK_WDT_CHECK_IDLE_TASK_CPU0=y
CONFIG_ESP_TASK_WDT_CHECK_IDLE_TASK_CPU1=y

# Interrupt watchdog
CONFIG_ESP_INT_WDT=y
CONFIG_ESP_INT_WDT_TIMEOUT_MS=300

# GPTimer Configuration
# Disabled IRAM placement to avoid linker literal pool issues
# Will add ~2-3µs latency but ensures reliable builds
CONFIG_GPTIMER_ENABLE_DEBUG_LOG=n
CONFIG_GPTIMER_ISR_IRAM_SAFE=n
CONFIG_GPTIMER_CTRL_FUNC_IN_IRAM=n

# RMT Configuration
CONFIG_RMT_ISR_IRAM_SAFE=y
CONFIG_RMT_ENABLE_DEBUG_LOG=n

# Compiler optimization for performance
CONFIG_COMPILER_OPTIMIZATION_PERF=y
CONFIG_COMPILER_OPTIMIZATION_ASSERTIONS_SILENT=y
CONFIG_COMPILER_CXX_EXCEPTIONS=n
CONFIG_COMPILER_CXX_RTTI=n

# Memory configuration
CONFIG_ESP_SYSTEM_EVENT_TASK_STACK_SIZE=4096
CONFIG_ESP_MAIN_TASK_STACK_SIZE=8192
CONFIG_MAIN_TASK_STACK_SIZE=8192

# ESP Timer configuration
CONFIG_ESP_TIMER_TASK_STACK_SIZE=4096
CONFIG_ESP_TIMER_INTERRUPT_LEVEL=1
CONFIG_ESP_TIMER_SUPPORTS_ISR_DISPATCH_METHOD=y

# NVS (Non-Volatile Storage)
CONFIG_NVS_ENCRYPTION=n

# GPIO
CONFIG_GPIO_ESP32_SUPPORT_SWITCH_SLP_PULL=y

# Partition table
CONFIG_PARTITION_TABLE_SINGLE_APP_LARGE=y

# Bootloader
CONFIG_BOOTLOADER_LOG_LEVEL_INFO=y

# Flash size
CONFIG_ESPTOOLPY_FLASHSIZE_8MB=y
CONFIG_ESPTOOLPY_FLASHSIZE="8MB"

# Component config
CONFIG_LOG_DEFAULT_LEVEL_INFO=y
CONFIG_LOG_MAXIMUM_LEVEL_VERBOSE=y
```
